## Kconfig
```kconfig
# Copyright (c) 2022 Laird Connectivity
# SPDX-License-Identifier: Apache-2.0

rsource "Kconfig.lcz_mqtt"
rsource "Kconfig.lcz_mqtt_ble"
rsource "Kconfig.lcz_mqtt_shadow_parser"
```

## Kconfig.lcz_mqtt
```kconfig
# Copyright (c) 2020-2022 Laird Connectivity
# SPDX-License-Identifier: Apache-2.0

menuconfig LCZ_MQTT
    bool "Config LCZ_MQTT Module"
    depends on MQTT_LIB
    depends on LCZ_PKI_AUTH
    depends on ATTR
    depends on LCZ_DNS
    depends on LCZ_SOFTWARE_RESET
    select ERRNO_STR
    select LCZ_SNPRINTK

if LCZ_MQTT

module=LCZ_MQTT
module-dep=LOG
module-str=LCZ_MQTT
source "${ZEPHYR_BASE}/subsys/logging/Kconfig.template.log_config"

config LCZ_MQTT_RX_THREAD_SIZE
    int "Size of RX thread in bytes"
    default 1024

config LCZ_MQTT_STATS
    bool "Enable statistics that can be viewed in debugger"

config LCZ_MQTT_RX_BUFFER_SIZE
    int "Size of buffer for MQTT rx path"
    default 128

config LCZ_MQTT_TX_BUFFER_SIZE
    int "Size of buffer for MQTT tx path"
    default 128

config LCZ_MQTT_SUBSCRIPTIONS
    bool "Enable subscriptions"

if LCZ_MQTT_SUBSCRIPTIONS

config LCZ_MQTT_SHADOW_IN_MAX_SIZE
    int "Maximum size of subscription/shadow that can be processed"
    default 128
    help
        AWS timestamps can make the shadow large

config LCZ_MQTT_SHADOW_TOPIC_MAX_SIZE
    int "Maximum size of topic"
    default 128

config LCZ_MQTT_LOG_MQTT_SUBSCRIPTION
    bool "Enable/Disable printing of received MQTT data"

config LCZ_MQTT_LOG_MQTT_SUBSCRIPTION_TOPIC
    bool "Enable/Disable printing of received MQTT topic"

endif # SUBSCRIPTIONS

config LCZ_MQTT_LOG_MQTT_PUBLISH
    bool "Print data published to LCZ_MQTT"

config LCZ_MQTT_LOG_MQTT_PUBLISH_TOPIC
    bool "Print the topic that docs are published"

config LCZ_MQTT_KEEP_ALIVE_VERBOSE
    bool "Log status for keep alive"
    depends on LCZ_MQTT_LOG_LEVEL >= LCZ_MQTT_LOG_LEVEL_INF

config LCZ_MQTT_CERT_TAG
    int "mbedTLS tag for CA, device cert, and private key"
    default 74

config LCZ_MQTT_AZURE
    bool "Increase MBEDTLS MPI size for communication with Azure"
    help
      Makes lcz_mqtt_mbedtls_config.h available to be used by app layer nrf-config-user.h.
      Requires nrf-config-user.h in the app to include lcz_mqtt_mbedtls_config.h

config LCZ_MQTT_SHELL
    bool "Enable MQTT shell commands"

if LCZ_MQTT_SHELL
    config LCZ_MQTT_SHELL_INIT_PRIORITY
    int "Application init priority for the MQTT shell"
    range 0 99
    default APPLICATION_INIT_PRIORITY
    help
      Recommended to be higher than main thread init priority.
endif

endif # LCZ_MQTT
```

## Kconfig.lcz_mqtt_ble
```kconfig
#
# Copyright (c) 2022 Laird Connectivity LLC
#
# SPDX-License-Identifier: LicenseRef-LairdConnectivity-Clause
#
menuconfig LCZ_MQTT_BLE
	bool "Enable MQTT BLE Laird Connectivity Sensor Data Advertisement Handler"
	depends on LCZ_LWM2M_GATEWAY_OBJ
	depends on !LCZ_LWM2M_UTIL_MANAGE_OBJ_INST
	depends on LCZ_MQTT
	depends on LCZ_BT_SCAN
	depends on LCZ_AD_FIND
	depends on LCZ_SENSOR_ADV_MATCH
	depends on BT_EXT_ADV
	select LCZ_SENSOR_EVENT

if LCZ_MQTT_BLE

module=LCZ_MQTT_BLE
module-str=MQTT_BLE
source "subsys/logging/Kconfig.template.log_config"

config LCZ_MQTT_BLE_EVENT_LOG_VERBOSE
	bool "Log event type, index, and RSSI at INF level"
	depends on LCZ_MQTT_BLE_LOG_LEVEL >= LCZ_MQTT_BLE_LOG_LEVEL_INF

config LCZ_MQTT_BLE_CREATE_LOG_VERBOSE
	bool "Log attempted creation of blocked devices"
	depends on LCZ_MQTT_BLE_LOG_LEVEL >= LCZ_MQTT_BLE_LOG_LEVEL_DBG

config LCZ_MQTT_BLE_EVENT_TIMEOUT_SECONDS
	int "Maximum time between events"
	default 900
	help
	  If a new advertising event is not received in this amount of time, then
	  the device instance may be removed from the gateway.

config LCZ_MQTT_BLE_STATS
	bool "Increment statistics for use with debugger"

config LCZ_MQTT_BLE_AD_LIST_SIZE
	int "Size in bytes of Advertisement List"
	range 65 4096
	default 1072

config LCZ_MQTT_BLE_PUBLISH_THRESHOLD
	int "Publish immediately if list size is past this threshold"
	range 1 4096
	default 768

config LCZ_MQTT_BLE_FIRST_PUBLISH
	int
	default 120
	help
	  Allow time for the gateway to initialize and connect to network

config LCZ_MQTT_PUBLISH_RATE
	int "Time in seconds between publishes of advertisement list"
	default 600

config LCZ_MQTT_BLE_LED
	bool "Flash LED for sensor data"
	depends on LCZ_LED
	help
	  The LED will flash after filtering advertisement data for sensors.
	  A file "led_config.h" defining all LEDs needs to be defined elsewhere.
	  In led_config.h BLE_LED index and BLE_ACTIVITY_LED_PATTERN need to
	  be defined to work with lcz_led_blink(...).

endif # LCZ_MQTT_BLE
```

## Kconfig.lcz_mqtt_shadow_parser
```kconfig
# Copyright (c) 2022 Laird Connectivity
# SPDX-License-Identifier: Apache-2.0

menuconfig LCZ_MQTT_SHADOW_PARSER
    bool "Enable Shadow Parser Module"
    depends on LCZ_MQTT_SUBSCRIPTIONS
    select JSMN

if LCZ_MQTT_SHADOW_PARSER

module=LCZ_MQTT_SHADOW_PARSER
module-dep=LOG
module-str=SHADOW_PARSER
source "${ZEPHYR_BASE}/subsys/logging/Kconfig.template.log_config"

config LCZ_MQTT_SHADOW_PARSER_FLAGS_AWS
    bool "Match topic strings used for AWS Demo"

endif # LCZ_MQTT_SHADOW_PARSER
```
